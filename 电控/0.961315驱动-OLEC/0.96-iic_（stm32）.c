//Drive_IC:SSD1315
//=-=-=-=-=-=-=-=-=-=-=-=-=-=-=-=-=-=-=-=-=-=-=-=-=-=-=-=-=-=-=-=-=-=-=-=-=-=-=-=-=-=-=-=-=-=-=-=-=-=

//#include <at89x51.h>
////#include <reg52.h>
//#include <intrins.h>





/* Includes ------------------------------------------------------------------*/
#include "i2c.h"
#include "gpio.h"

#define I2C_SCL_Pin GPIO_PIN_10
#define I2C_SCL_GPIO_Port GPIOB
#define I2C_SDA_Pin GPIO_PIN_11
#define I2C_SDA_GPIO_Port GPIOB

#define I2C_LENGTH_BYTE 8u;
#define OLED_ROW_INDEX_MIN 0u;
#define OLED_ROW_INDEX_MAX 7u;
#define OLED_CLOM_INDEX_MIN 0u;
#define OLED_CLOM_INDEX_MAX 127u;

/* Buffer used for transmission */
uint8_t FileBufferA[]={
0xFF,0x01,0x01,0x01,0x01,0x01,0x01,0x01,0x01,0x01,0x01,0x01,0x01,0x01,0x01,0x01,
0x01,0x01,0x01,0x01,0x01,0x01,0x01,0x01,0x01,0x01,0x01,0x01,0x01,0x01,0x01,0x01,
0x01,0x01,0x01,0x01,0x01,0x01,0x01,0x01,0x01,0x01,0x01,0x01,0x01,0x01,0x01,0x01,
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0x80,0x80,0x80,0x80,0x80,0x80,0x80,0x80,0x80,0x80,0x80,0x80,0x80,0x80,0x80,0xFF};

uint8_t FileBufferB[]={
0x00,0x00,0x00,0xF0,0x08,0x04,0x04,0x08,0xF0,0x00,0x04,0xFC,0x04,0x00,0x00,0x00,
0x00,0x04,0xFC,0x44,0x44,0xE4,0x0C,0x00,0x04,0xFC,0x04,0x04,0x08,0xF0,0x00,0xA8,
0xAE,0x98,0xFF,0xAC,0x8A,0x10,0xFC,0x0B,0x88,0x78,0x08,0x00,0x88,0x86,0x92,0x92,
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0x20,0x20,0x20,0x20,0x10,0x0F,0x00,0x00,0x07,0x18,0x20,0x20,0x20,0x20,0x10,0x0C};

void I2CStart(void);
void I2CStop(void);
void I2CAcknowladge(void);
void I2CNonAcknowladge(void);
void I2CSendControl(uint8_t);
void OledSendCommand(uint8_t);
void OledInit(void);
void OledDisplay(uint8_t *);

void MX_I2C2_Init(void) {

    GPIO_InitTypeDef GPIO_InitStruct = {0};

    /* GPIO Ports Clock Enable */
    __HAL_RCC_GPIOB_CLK_ENABLE();

    /**I2C2 GPIO Configuration
     PB10     ------> I2C2_SCL
     PB11     ------> I2C2_SDA
     */
    GPIO_InitStruct.Pin = I2C_SCL_Pin | I2C_SDA_Pin;
    GPIO_InitStruct.Mode = GPIO_MODE_OUTPUT_OD;
    GPIO_InitStruct.Pull = GPIO_PULLUP;
    GPIO_InitStruct.Speed = GPIO_SPEED_FREQ_HIGH;
    HAL_GPIO_Init(GPIOB, &GPIO_InitStruct);
}

/*Software Delay*/
void delay_ms(uint16_t t)
{
    uint8_t i,j;
    while(--t){
    i=50;
    j=100;
        while(--j){
            while(--i);
        }
    }
}

void uDelay(uint8_t l)
{
    while(l--);
}

void Delay(uint8_t n)
{
    uint8_t i, j, k;
    for(k = 0; k < n; k++){
        for(i = 0; i < 131; i++){
            for(j = 0 ;j < 15; j++){
                uDelay(203);
            }
        }
    }
}

/*Software IIC*/
void I2CStart(void)
{
    HAL_GPIO_WritePin(GPIOB, I2C_SDA_Pin, GPIO_PIN_RESET);
    HAL_GPIO_WritePin(GPIOB, I2C_SCL_Pin, GPIO_PIN_SET);
    HAL_GPIO_WritePin(GPIOB, I2C_SCL_Pin, GPIO_PIN_RESET);
    I2CSendControl(0x78);
    I2CAcknowladge();
}

void I2CStop(void)
{
    HAL_GPIO_WritePin(GPIOB, I2C_SCL_Pin, GPIO_PIN_SET);
    HAL_GPIO_WritePin(GPIOB, I2C_SDA_Pin, GPIO_PIN_RESET);
    HAL_GPIO_WritePin(GPIOB, I2C_SDA_Pin, GPIO_PIN_SET);
}

void I2CAcknowladge(void)
{
    HAL_GPIO_WritePin(GPIOB, I2C_SDA_Pin, GPIO_PIN_SET);
    HAL_GPIO_WritePin(GPIOB, I2C_SCL_Pin, GPIO_PIN_SET);
    HAL_GPIO_WritePin(GPIOB, I2C_SCL_Pin, GPIO_PIN_RESET);
}

void I2CNonAcknowladge(void)
{
    HAL_GPIO_WritePin(GPIOB, I2C_SDA_Pin, GPIO_PIN_RESET);
    HAL_GPIO_WritePin(GPIOB, I2C_SCL_Pin, GPIO_PIN_SET);
    HAL_GPIO_WritePin(GPIOB, I2C_SCL_Pin, GPIO_PIN_RESET);
}

void I2CSendControl(uint8_t tOperationCmd)
{
    uint8_t tLength = I2C_LENGTH_BYTE;    // Send Command

    while(tLength--)
    {
        if(tOperationCmd & 0x80)
        {
            HAL_GPIO_WritePin(GPIOB, I2C_SDA_Pin, GPIO_PIN_SET);
        }
        else
        {
            HAL_GPIO_WritePin(GPIOB, I2C_SDA_Pin, GPIO_PIN_RESET);
        }
        HAL_GPIO_WritePin(GPIOB, I2C_SCL_Pin, GPIO_PIN_SET);
        HAL_GPIO_WritePin(GPIOB, I2C_SCL_Pin, GPIO_PIN_RESET);
        tOperationCmd = tOperationCmd << 1;
    }
}

/*Oled Base Driver*/
void OledSendCommand(uint8_t tData)
{
    I2CStart();
    I2CSendControl(0x00);
    I2CAcknowladge();
    I2CSendControl(tData);
    I2CAcknowladge();
    I2CStop();
}

void OledSendData(uint8_t tData)
{
    I2CStart();
    I2CSendControl(0x40);
    I2CAcknowladge();
    I2CSendControl(tData);
    I2CAcknowladge();
    I2CStop();
}

/*Oled Function*/
void OledInit(void)
{
    OledSendCommand(0xae);    //--turn off oled panel

    OledSendCommand(0x00);    //--set low column address
    OledSendCommand(0x10);    //--set high column address

    OledSendCommand(0x40);    //--set start line address

    OledSendCommand(0xb0);    //--set page address

    OledSendCommand(0x81);    //--set contrast control register
    OledSendCommand(0xff);

    OledSendCommand(0xa1);    //--set segment re-map 127 to 0   a0:0 to seg127
    OledSendCommand(0xa6);    //--set normal display

    OledSendCommand(0xc9);    //--set com(N-1)to com0  c0:com0 to com(N-1)

    OledSendCommand(0xa8);    //--set multiples ratio(1to64)
    OledSendCommand(0x3f);    //--1/64 duty

    OledSendCommand(0xd3);    //--set display offset
    OledSendCommand(0x00);    //--not offset

    OledSendCommand(0xd5);    //--set display clock divide ratio/oscillator frequency
    OledSendCommand(0x80);    //--set divide ratio

    OledSendCommand(0xd9);    //--set pre-charge period
    OledSendCommand(0xf1);

    OledSendCommand(0xda);    //--set com pins hardware configuration
    OledSendCommand(0x12);

    OledSendCommand(0xdb);    //--set vcomh
    OledSendCommand(0x40);

    OledSendCommand(0x8d);    //--set chare pump enable/disable
    OledSendCommand(0x14);    //--set(0x10) disable

    OledSendCommand(0xaf);    //--turn on oled panel
}

void OledDisplay(uint8_t * pFileBuffer)
{
    uint16_t tIdxBuffer = 0u;
    for(uint8_t IdxClom = OLED_ROW_INDEX_MIN; IdxClom <= OLED_ROW_INDEX_MAX; IdxClom++)
    {
        OledSendCommand(0x22);      //--set page1
        OledSendCommand(IdxClom);   //--set start page
        OledSendCommand(0x07);      //--set end page

        for(uint8_t IdxRow = OLED_CLOM_INDEX_MIN; IdxRow <= OLED_CLOM_INDEX_MAX ; IdxRow++)
        {
            OledSendData(pFileBuffer[tIdxBuffer]);
            tIdxBuffer++;
        }
    }
}

/*Oled Display Application use Software IIC Communication Control*/
void main(void)
{
    OledInit();

    for(;;)
    {
        OledDisplay(FileBufferA);
        osDelay(osWait2s);
        OledDisplay(FileBufferB);
        osDelay(osWait1s);
    }
}
